/* USER CODE BEGIN Header */
/**
  ******************************************************************************
  * @file           : main.c
  * @brief          : Main program body
  ******************************************************************************
  * @attention
  *
  * Copyright (c) 2023 STMicroelectronics.
  * All rights reserved.
  *
  * This software is licensed under terms that can be found in the LICENSE file
  * in the root directory of this software component.
  * If no LICENSE file comes with this software, it is provided AS-IS.
  *
  ******************************************************************************
  */
/* USER CODE END Header */
/* Includes ------------------------------------------------------------------*/
#include "main.h"
#include "spi.h"
#include "usart.h"
#include "gpio.h"

/* Private includes ----------------------------------------------------------*/
/* USER CODE BEGIN Includes */
#include "st7789.h"
/* USER CODE END Includes */

/* Private typedef -----------------------------------------------------------*/
/* USER CODE BEGIN PTD */

/* USER CODE END PTD */

/* Private define ------------------------------------------------------------*/
/* USER CODE BEGIN PD */
/* USER CODE END PD */

/* Private macro -------------------------------------------------------------*/
/* USER CODE BEGIN PM */

/* USER CODE END PM */

/* Private variables ---------------------------------------------------------*/

/* USER CODE BEGIN PV */
/* USER CODE END PV */

/* Private function prototypes -----------------------------------------------*/
void SystemClock_Config(void);
/* USER CODE BEGIN PFP */
char* parser(uint16_t);
/* USER CODE END PFP */

/* Private user code ---------------------------------------------------------*/
/* USER CODE BEGIN 0 */
//uint16_t* im =

/* USER CODE END 0 */

/**
  * @brief  The application entry point.
  * @retval int
  */
int main(void)
{
  /* USER CODE BEGIN 1 */

  /* USER CODE END 1 */

  /* MCU Configuration--------------------------------------------------------*/

  /* Reset of all peripherals, Initializes the Flash interface and the Systick. */
  HAL_Init();

  /* USER CODE BEGIN Init */

  /* USER CODE END Init */

  /* Configure the system clock */
  SystemClock_Config();

  /* USER CODE BEGIN SysInit */

  /* USER CODE END SysInit */

  /* Initialize all configured peripherals */
  MX_GPIO_Init();
  MX_USART2_UART_Init();
  MX_SPI1_Init();
  /* USER CODE BEGIN 2 */
  uint16_t number;
  extern uint8_t flag_change;
  number = 0;
  flag_change = 0;
  ST7789_Init(130, 131);
  ST7789_MemAccessModeSet(3, 0, 0, 1);
  ST7789_InversionMode(0);
  ST7789_SetBL(100);
//  uint16_t orange = RGB565(255, 102, 0);
//  uint16_t brown = RGB565(128, 64, 48);
//  uint16_t pink = RGB565(252, 15, 192);
//  ST7789_FillScreen(BLACK);
//  HAL_Delay(500);
////  ST7789_DrawCircleFilled(20, 30, 10, GREEN);
//  ST7789_String(21, 60, "reSET", BLACK, orange);
//  ST7789_DrawRectangleFilled(10, 30+7, 40, 40+7, brown);
//  ST7789_DrawRectangleFilled(10, 20+7, 40, 30+7, YELLOW);
//  ST7789_DrawRectangleFilled(10, 10+7, 40, 20+7, pink);
//  ST7789_DrawCircleFilled(25, 10, 5, RED);
//  char str_numb [10];
//  snprintf(str_numb, sizeof(str_numb), "%i", number);
//  ST7789_String(56, 100, str_numb, BLACK, WHITE);
uint16_t *im = {119, 103, 103, 109, 145, 143, 139, 139, 139, 139, 139, 139, 139,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 255,
		55, 33, 32, 33, 63, 81, 77, 77, 76, 77, 77, 77,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 255,
		60, 38, 35, 28, 35, 81, 79, 79, 83, 81, 81, 81,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 255,
		54, 32, 32, 34, 40, 68, 77, 81, 86, 86, 86, 84,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 255,
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		254, 255, 255, 255, 255, 255, 255, 182, 65, 90, 79, 49,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 255, 254		};
uint16_t num = 0;
  for (int i =0; i<50;i++){
	  for (int j = 0; j < 50; j++){
		  ST7789_DrawPixel(i, j, RGB565(0,0,im[num]));
		  num++;
	  }
  }
  /* USER CODE END 2 */

  /* Infinite loop */
  /* USER CODE BEGIN WHILE */
  while (1)
  {
//	  if (flag_change == 1){
//		  number++;
//		  snprintf(str_numb, sizeof(str_numb), "%i", number);
//		  if(number < 10)
//			  ST7789_String(56, 100, str_numb, BLACK, WHITE);
//		  else if (number < 100)
//			  ST7789_String(47, 100, str_numb, BLACK, WHITE);
//		  else
//			  ST7789_String(39, 100, str_numb, BLACK, WHITE);
//		  flag_change = 0;
//		  if (number == 15){
//			  ST7789_FillScreen(BLACK);
//			  ST7789_String(30, 0, "Very", BLACK, WHITE);
//			  ST7789_String(13, 50, "Simple", BLACK, WHITE);
//			  ST7789_String(30, 100, "Task", BLACK, WHITE);
//		  }
//		  if (number == 16){
//			  ST7789_FillScreen(BLACK);
//			  ST7789_String(21, 60, "reSET", BLACK, orange);
//			  ST7789_DrawRectangleFilled(10, 30+7, 40, 40+7, brown);
//			  ST7789_DrawRectangleFilled(10, 20+7, 40, 30+7, YELLOW);
//			  ST7789_DrawRectangleFilled(10, 10+7, 40, 20+7, pink);
//			  ST7789_DrawCircleFilled(25, 10, 5, RED);
//			  ST7789_String(47, 100, str_numb, BLACK, WHITE);
//		  }
//	  }

    /* USER CODE END WHILE */

    /* USER CODE BEGIN 3 */
  }
  /* USER CODE END 3 */
}

/**
  * @brief System Clock Configuration
  * @retval None
  */
void SystemClock_Config(void)
{
  LL_FLASH_SetLatency(LL_FLASH_LATENCY_0);
  while(LL_FLASH_GetLatency()!= LL_FLASH_LATENCY_0)
  {
  }
  LL_RCC_HSI_Enable();

   /* Wait till HSI is ready */
  while(LL_RCC_HSI_IsReady() != 1)
  {

  }
  LL_RCC_HSI_SetCalibTrimming(16);
  LL_RCC_SetAHBPrescaler(LL_RCC_SYSCLK_DIV_1);
  LL_RCC_SetAPB1Prescaler(LL_RCC_APB1_DIV_1);
  LL_RCC_SetAPB2Prescaler(LL_RCC_APB2_DIV_1);
  LL_RCC_SetSysClkSource(LL_RCC_SYS_CLKSOURCE_HSI);

   /* Wait till System clock is ready */
  while(LL_RCC_GetSysClkSource() != LL_RCC_SYS_CLKSOURCE_STATUS_HSI)
  {

  }
  LL_SetSystemCoreClock(8000000);

   /* Update the time base */
  if (HAL_InitTick (TICK_INT_PRIORITY) != HAL_OK)
  {
    Error_Handler();
  }
}

/* USER CODE BEGIN 4 */
char* parser(uint16_t number){
	char str_numb [3];
	snprintf(str_numb, sizeof(str_numb), "%d", number);
	return str_numb;
}
/* USER CODE END 4 */

/**
  * @brief  This function is executed in case of error occurrence.
  * @retval None
  */
void Error_Handler(void)
{
  /* USER CODE BEGIN Error_Handler_Debug */
  /* User can add his own implementation to report the HAL error return state */
  __disable_irq();
  while (1)
  {
  }
  /* USER CODE END Error_Handler_Debug */
}

#ifdef  USE_FULL_ASSERT
/**
  * @brief  Reports the name of the source file and the source line number
  *         where the assert_param error has occurred.
  * @param  file: pointer to the source file name
  * @param  line: assert_param error line source number
  * @retval None
  */
void assert_failed(uint8_t *file, uint32_t line)
{
  /* USER CODE BEGIN 6 */
  /* User can add his own implementation to report the file name and line number,
     ex: printf("Wrong parameters value: file %s on line %d\r\n", file, line) */
  /* USER CODE END 6 */
}
#endif /* USE_FULL_ASSERT */
